/*
 * This software is contributed or developed by KYOCERA Corporation.
 * (C) 2014 KYOCERA Corporation
 * (C) 2015 KYOCERA Corporation
 * (C) 2016 KYOCERA Corporation
 */
/* Copyright (c) 2013, The Linux Foundation. All rights reserved.
 *
 * This program is free software; you can redistribute it and/or modify
 * it under the terms of the GNU General Public License version 2 and
 * only version 2 as published by the Free Software Foundation.
 *
 * This program is distributed in the hope that it will be useful,
 * but WITHOUT ANY WARRANTY; without even the implied warranty of
 * MERCHANTABILITY or FITNESS FOR A PARTICULAR PURPOSE.  See the
 * GNU General Public License for more details.
 */

/*---------------------------------------------------------------------------
 * This file is autogenerated file using gcdb parser. Please do not edit it.
 * Update input XML file to add a new entry or update variable in this file
 * VERSION = "1.0"
 *---------------------------------------------------------------------------*/
&mdss_mdp {
	dsi_kc_hx8394_720_vid: qcom,mdss_dsi_kc_hx8394_720p_video {
		qcom,mdss-dsi-panel-name = "kc hx8394 720p video mode dsi panel";
		qcom,mdss-dsi-panel-controller = <&mdss_dsi0>;
		qcom,mdss-dsi-panel-type = "dsi_video_mode";
		qcom,mdss-dsi-panel-destination = "display_1";
		qcom,mdss-dsi-panel-framerate = <60>;
		qcom,mdss-dsi-virtual-channel-id = <0>;
		qcom,mdss-dsi-stream = <0>;
		qcom,mdss-dsi-panel-width = <720>;
		qcom,mdss-dsi-panel-height = <1280>;
		qcom,mdss-dsi-h-front-porch = <72>;
		qcom,mdss-dsi-h-back-porch = <72>;
		qcom,mdss-dsi-h-pulse-width = <12>;
		qcom,mdss-dsi-h-sync-skew = <0>;
		qcom,mdss-dsi-v-back-porch = <12>;
		qcom,mdss-dsi-v-front-porch = <15>;
		qcom,mdss-dsi-v-pulse-width = <4>;
		qcom,mdss-dsi-h-left-border = <0>;
		qcom,mdss-dsi-h-right-border = <0>;
		qcom,mdss-dsi-v-top-border = <0>;
		qcom,mdss-dsi-v-bottom-border = <0>;
		qcom,mdss-dsi-bpp = <24>;
		qcom,mdss-dsi-underflow-color = <0x00>;
		qcom,mdss-dsi-border-color = <0>;
		qcom,mdss-dsi-on-command = [
					39 01 00 00 00 00 04 B9 FF 83 94// Set EXTC
					39 01 00 00 00 00 07 BA 33 83 60 65 B2 09// Set MIPI
					39 01 00 00 00 00 10 B1 6C 12 12 47 07 11 F1 40 FF 54 23 8A C0 C9 58// Set Power
					39 01 00 00 00 00 0C B2 00 64 0E 0D 32 1C 08 08 1C 4D 00//Set Display
					39 01 00 00 00 00 0D B4 00 FF 71 6C 71 6C 71 6C 01 70 30 70// Set CYC
					39 01 00 00 00 00 04 B6 80 80 E0// Set VCOM
					39 01 00 00 00 00 2B E0 00 1F 1A 32 39 3F 23 3D 07 0A 0A 15 0C 0F 12 11 12 06 10 12 16 00 1F 1A 32 39 3F 23 3D 06 08 0A 15 0D 10 13 11 13 07 10 12 17// Set Gamma
					39 01 00 00 00 00 26 D3 00 07 00 40 07 10 00 08 10 08 00 08 54 15 0E 05 0E 02 15 06 05 06 47 44 0A 0A 4B 10 07 07 08 00 00 00 0A 00 01// Set GIP
					39 01 00 00 00 00 2D D5 1A 1A 1B 1B 00 01 02 03 04 05 06 07 08 09 0A 0B 24 25 18 18 26 27 18 18 18 18 18 18 18 18 18 18 18 18 18 18 18 18 20 21 18 18 18 18//GIP Forward
					39 01 00 00 00 00 2D D6 1A 1A 1B 1B 0B 0A 09 08 07 06 05 04 03 02 01 00 21 20 58 58 27 26 18 18 18 18 18 18 18 18 18 18 18 18 18 18 18 18 25 24 18 18 18 18//GIP Backward
					39 01 00 00 00 00 02 CC 05//Set Panel
					39 01 00 00 00 00 03 C0 30 14//Set CO
					39 01 00 00 00 00 05 C7 00 C0 00 C0//Set Tcon Option
					05 01 00 00 C8 00 02 11 00//Sleep Out + 200ms
					39 01 00 00 00 00 03 E4 51 00//Set Chemode
					39 01 00 00 00 00 13 E5 00 0C 1F 07 04 00 08 20 00 10 00 00 08 06 04 00 80 02//Set Che
					39 01 00 00 00 00 12 E6 40 00 00 05 05 08 04 04 04 04 08 10 04 05 04 10 0C//Set Chesel Enable color enhance
					05 01 00 00 10 00 02 29 00// Display On+16ms
					];
		qcom,mdss-dsi-on-command-ws11 = [
					39 01 00 00 00 00 04 B9 FF 83 94// Set EXTC
					39 01 00 00 00 00 07 BA 33 83 A0 65 B2 09// Set MIPI
					39 01 00 00 00 00 10 B1 6C 12 12 47 07 11 F1 80 FF 54 23 89 C0 C9 58// Set Power
					39 01 00 00 00 00 0C B2 00 64 0E 0D 32 1C 08 08 1C 4D 00//Set Display
					39 01 00 00 00 00 0D B4 00 FF 71 6C 71 6C 71 6C 01 70 30 70// Set CYC
					39 01 00 00 00 00 04 B6 80 80 E0// Set VCOM
					39 01 00 00 00 00 2B E0 00 29 2C 2F 31 3F 2A 3F 06 0A 0C 17 0E 11 14 12 14 08 12 12 16 00 29 2B 2D 32 3F 2A 3F 08 0B 0C 17 0D 10 13 12 12 06 11 13 18// Set Gamma
					39 01 00 00 00 00 26 D3 00 07 00 40 07 10 00 08 10 08 00 08 54 15 0E 05 0E 02 15 06 05 06 47 44 0A 0A 4B 10 07 07 08 00 00 00 0A 00 01// Set GIP
					39 01 00 00 00 00 2D D5 1A 1A 1B 1B 00 01 02 03 04 05 06 07 08 09 0A 0B 24 25 18 18 26 27 18 18 18 18 18 18 18 18 18 18 18 18 18 18 18 18 20 21 18 18 18 18//GIP Forward
					39 01 00 00 00 00 2D D6 1A 1A 1B 1B 0B 0A 09 08 07 06 05 04 03 02 01 00 21 20 58 58 27 26 18 18 18 18 18 18 18 18 18 18 18 18 18 18 18 18 25 24 18 18 18 18//GIP Backward
					39 01 00 00 00 00 02 CC 05//Set Panel
					39 01 00 00 00 00 05 C7 00 C0 00 C0//Set Tcon Option
					05 01 00 00 C8 00 02 11 00//Sleep Out + 200ms
					39 01 00 00 00 00 03 E4 51 00//Set Chemode
					39 01 00 00 00 00 13 E5 00 0C 1F 07 04 00 08 20 00 10 00 00 08 06 04 00 80 02//Set Che
					39 01 00 00 00 00 12 E6 40 00 00 05 05 08 04 04 04 04 08 10 04 05 04 10 0C//Set Chesel Enable color enhance
					05 01 00 00 10 00 02 29 00// Display On+16ms
					];
		qcom,mdss-dsi-off-command = [
					05 01 00 00 40 00 02 28 00
					05 01 00 00 80 00 02 10 00];
		qcom,mdss-dsi-on-command-state = "dsi_lp_mode";
		qcom,mdss-dsi-off-command-state = "dsi_hs_mode";
		qcom,mdss-dsi-h-sync-pulse = <1>;
		qcom,mdss-dsi-traffic-mode = "non_burst_sync_event";
		qcom,mdss-dsi-lane-map = "lane_map_0123";
		qcom,mdss-dsi-bllp-eof-power-mode;
		qcom,mdss-dsi-bllp-power-mode;
		qcom,mdss-dsi-force-clk-hs;
		qcom,mdss-dsi-lane-0-state;
		qcom,mdss-dsi-lane-1-state;
		qcom,mdss-dsi-lane-2-state;
		qcom,mdss-dsi-lane-3-state;
		qcom,mdss-dsi-panel-timings = [7B 1A 10 00 3E 40 16 1E 15 03 04 00];
		qcom,mdss-dsi-t-clk-post = <0x04>;
		qcom,mdss-dsi-t-clk-pre = <0x1A>;
		qcom,mdss-dsi-bl-min-level = <1>;
		qcom,mdss-dsi-bl-max-level = <255>;
		qcom,mdss-dsi-dma-trigger = "trigger_sw";
		qcom,mdss-dsi-mdp-trigger = "none";
		qcom,mdss-dsi-bl-pmic-control-type = "bl_ctrl_dcs";
		qcom,mdss-dsi-reset-sequence = <1 20>, <0 1>, <1 20>;
		qcom,mdss-pan-physical-width-dimension = <71>;
		qcom,mdss-pan-physical-height-dimension = <126>;
		qcom,esd-check-enabled;
		qcom,mdss-dsi-panel-status-check-mode = "bta_check";
		qcom,mdss-dsi-pan-enable-dynamic-fps;
		qcom,mdss-dsi-pan-fps-update = "dfps_suspend_resume_mode";

		kc,pcc_r = <0x9000>;
		kc,pcc_g = <0x7000>;
		kc,pcc_b = <0x7800>;
		kc,r_stage_enable = <1 1 1 1 1 1 1 1 1 1 1 1 1 1 1 1>;
		kc,g_stage_enable = <1 1 1 1 1 1 1 1 1 1 1 1 1 1 1 1>;
		kc,b_stage_enable = <1 1 1 1 1 1 1 1 1 1 1 1 1 1 1 1>;
		kc,r_x_start = <
			0x0000 0x0002 0x000e 0x0033 0x008a 0x0138 0x026f 0x046f
			0x0787 0x0c18 0x0fff 0x0fff 0x0fff 0x0fff 0x0fff 0x0fff>;
		kc,r_slope = <
			0x5d0d 0x0f0f 0x0697 0x039e 0x023d 0x017f 0x010e 0x00c7
			0x0098 0x007d 0x0000 0x0000 0x0000 0x0000 0x0000 0x0000>;
		kc,r_offset = <
			0x0000 0x0475 0x0a23 0x11dc 0x1bcd 0x2810 0x36ad 0x47a8
			0x5b03 0x707b 0x7f80 0x7f80 0x7f80 0x7f80 0x7f80 0x7f80>;
		kc,g_x_start = <
			0x0000 0x0002 0x000e 0x0033 0x008a 0x0138 0x026f 0x046f
			0x0787 0x0c18 0x0fff 0x0fff 0x0fff 0x0fff 0x0fff 0x0fff>;
		kc,g_slope = <
			0x5d0d 0x0f0f 0x0697 0x039e 0x023d 0x017f 0x010e 0x00c7
			0x0098 0x007d 0x0000 0x0000 0x0000 0x0000 0x0000 0x0000>;
		kc,g_offset = <
			0x0000 0x0475 0x0a23 0x11dc 0x1bcd 0x2810 0x36ad 0x47a8
			0x5b03 0x707b 0x7f80 0x7f80 0x7f80 0x7f80 0x7f80 0x7f80>;
		kc,b_x_start = <
			0x0000 0x0002 0x000e 0x0033 0x008a 0x0138 0x026f 0x046f
			0x0787 0x0c18 0x0fff 0x0fff 0x0fff 0x0fff 0x0fff 0x0fff>;
		kc,b_slope = <
			0x5d0d 0x0f0f 0x0697 0x039e 0x023d 0x017f 0x010e 0x00c7
			0x0098 0x007d 0x0000 0x0000 0x0000 0x0000 0x0000 0x0000>;
		kc,b_offset = <
			0x0000 0x0475 0x0a23 0x11dc 0x1bcd 0x2810 0x36ad 0x47a8
			0x5b03 0x707b 0x7f80 0x7f80 0x7f80 0x7f80 0x7f80 0x7f80>;
		kc,igc_c0_c1_data = <
			0x00000000 0x00000000 0x00000000 0x00000000
			0x00000000 0x00010001 0x00010001 0x00020002
			0x00020002 0x00030003 0x00030003 0x00040004
			0x00050005 0x00060006 0x00070007 0x00080008
			0x00090009 0x000b000b 0x000c000c 0x000e000e
			0x000f000f 0x00110011 0x00130013 0x00150015
			0x00170017 0x00190019 0x001b001b 0x001d001d
			0x00200020 0x00220022 0x00250025 0x00280028
			0x002b002b 0x002e002e 0x00310031 0x00340034
			0x00370037 0x003b003b 0x003e003e 0x00420042
			0x00460046 0x00490049 0x004d004d 0x00520052
			0x00560056 0x005a005a 0x005f005f 0x00630063
			0x00680068 0x006d006d 0x00720072 0x00770077
			0x007c007c 0x00810081 0x00870087 0x008c008c
			0x00920092 0x00980098 0x009e009e 0x00a400a4
			0x00aa00aa 0x00b000b0 0x00b600b6 0x00bd00bd
			0x00c400c4 0x00ca00ca 0x00d100d1 0x00d800d8
			0x00e000e0 0x00e700e7 0x00ee00ee 0x00f600f6
			0x00fe00fe 0x01050105 0x010d010d 0x01150115
			0x011e011e 0x01260126 0x012e012e 0x01370137
			0x01400140 0x01480148 0x01510151 0x015b015b
			0x01640164 0x016d016d 0x01770177 0x01800180
			0x018a018a 0x01940194 0x019e019e 0x01a801a8
			0x01b301b3 0x01bd01bd 0x01c801c8 0x01d301d3
			0x01dd01dd 0x01e801e8 0x01f401f4 0x01ff01ff
			0x020a020a 0x02160216 0x02210221 0x022d022d
			0x02390239 0x02450245 0x02520252 0x025e025e
			0x026b026b 0x02770277 0x02840284 0x02910291
			0x029e029e 0x02ab02ab 0x02b902b9 0x02c602c6
			0x02d402d4 0x02e202e2 0x02f002f0 0x02fe02fe
			0x030c030c 0x031a031a 0x03290329 0x03370337
			0x03460346 0x03550355 0x03640364 0x03740374
			0x03830383 0x03920392 0x03a203a2 0x03b203b2
			0x03c203c2 0x03d203d2 0x03e203e2 0x03f303f3
			0x04030403 0x04140414 0x04250425 0x04360436
			0x04470447 0x04580458 0x046a046a 0x047b047b
			0x048d048d 0x049f049f 0x04b104b1 0x04c304c3
			0x04d504d5 0x04e804e8 0x04fa04fa 0x050d050d
			0x05200520 0x05330533 0x05460546 0x055a055a
			0x056d056d 0x05810581 0x05950595 0x05a905a9
			0x05bd05bd 0x05d105d1 0x05e505e5 0x05fa05fa
			0x060f060f 0x06240624 0x06390639 0x064e064e
			0x06630663 0x06790679 0x068e068e 0x06a406a4
			0x06ba06ba 0x06d006d0 0x06e606e6 0x06fd06fd
			0x07130713 0x072a072a 0x07410741 0x07580758
			0x076f076f 0x07860786 0x079e079e 0x07b607b6
			0x07cd07cd 0x07e507e5 0x07fd07fd 0x08160816
			0x082e082e 0x08470847 0x085f085f 0x08780878
			0x08910891 0x08ab08ab 0x08c408c4 0x08de08de
			0x08f708f7 0x09110911 0x092b092b 0x09450945
			0x09600960 0x097a097a 0x09950995 0x09af09af
			0x09ca09ca 0x09e609e6 0x0a010a01 0x0a1c0a1c
			0x0a380a38 0x0a540a54 0x0a6f0a6f 0x0a8c0a8c
			0x0aa80aa8 0x0ac40ac4 0x0ae10ae1 0x0afd0afd
			0x0b1a0b1a 0x0b370b37 0x0b540b54 0x0b720b72
			0x0b8f0b8f 0x0bad0bad 0x0bcb0bcb 0x0be90be9
			0x0c070c07 0x0c250c25 0x0c440c44 0x0c620c62
			0x0c810c81 0x0ca00ca0 0x0cbf0cbf 0x0cdf0cdf
			0x0cfe0cfe 0x0d1e0d1e 0x0d3e0d3e 0x0d5d0d5d
			0x0d7e0d7e 0x0d9e0d9e 0x0dbe0dbe 0x0ddf0ddf
			0x0e000e00 0x0e210e21 0x0e420e42 0x0e630e63
			0x0e840e84 0x0ea60ea6 0x0ec80ec8 0x0eea0eea
			0x0f0c0f0c 0x0f2e0f2e 0x0f500f50 0x0f730f73
			0x0f960f96 0x0fb90fb9 0x0fdc0fdc 0x0fff0fff>;
		kc,igc_c2_data = <
			0x0000 0x0000 0x0000 0x0000
			0x0000 0x0001 0x0001 0x0002
			0x0002 0x0003 0x0003 0x0004
			0x0005 0x0006 0x0007 0x0008
			0x0009 0x000b 0x000c 0x000e
			0x000f 0x0011 0x0013 0x0015
			0x0017 0x0019 0x001b 0x001d
			0x0020 0x0022 0x0025 0x0028
			0x002b 0x002e 0x0031 0x0034
			0x0037 0x003b 0x003e 0x0042
			0x0046 0x0049 0x004d 0x0052
			0x0056 0x005a 0x005f 0x0063
			0x0068 0x006d 0x0072 0x0077
			0x007c 0x0081 0x0087 0x008c
			0x0092 0x0098 0x009e 0x00a4
			0x00aa 0x00b0 0x00b6 0x00bd
			0x00c4 0x00ca 0x00d1 0x00d8
			0x00e0 0x00e7 0x00ee 0x00f6
			0x00fe 0x0105 0x010d 0x0115
			0x011e 0x0126 0x012e 0x0137
			0x0140 0x0148 0x0151 0x015b
			0x0164 0x016d 0x0177 0x0180
			0x018a 0x0194 0x019e 0x01a8
			0x01b3 0x01bd 0x01c8 0x01d3
			0x01dd 0x01e8 0x01f4 0x01ff
			0x020a 0x0216 0x0221 0x022d
			0x0239 0x0245 0x0252 0x025e
			0x026b 0x0277 0x0284 0x0291
			0x029e 0x02ab 0x02b9 0x02c6
			0x02d4 0x02e2 0x02f0 0x02fe
			0x030c 0x031a 0x0329 0x0337
			0x0346 0x0355 0x0364 0x0374
			0x0383 0x0392 0x03a2 0x03b2
			0x03c2 0x03d2 0x03e2 0x03f3
			0x0403 0x0414 0x0425 0x0436
			0x0447 0x0458 0x046a 0x047b
			0x048d 0x049f 0x04b1 0x04c3
			0x04d5 0x04e8 0x04fa 0x050d
			0x0520 0x0533 0x0546 0x055a
			0x056d 0x0581 0x0595 0x05a9
			0x05bd 0x05d1 0x05e5 0x05fa
			0x060f 0x0624 0x0639 0x064e
			0x0663 0x0679 0x068e 0x06a4
			0x06ba 0x06d0 0x06e6 0x06fd
			0x0713 0x072a 0x0741 0x0758
			0x076f 0x0786 0x079e 0x07b6
			0x07cd 0x07e5 0x07fd 0x0816
			0x082e 0x0847 0x085f 0x0878
			0x0891 0x08ab 0x08c4 0x08de
			0x08f7 0x0911 0x092b 0x0945
			0x0960 0x097a 0x0995 0x09af
			0x09ca 0x09e6 0x0a01 0x0a1c
			0x0a38 0x0a54 0x0a6f 0x0a8c
			0x0aa8 0x0ac4 0x0ae1 0x0afd
			0x0b1a 0x0b37 0x0b54 0x0b72
			0x0b8f 0x0bad 0x0bcb 0x0be9
			0x0c07 0x0c25 0x0c44 0x0c62
			0x0c81 0x0ca0 0x0cbf 0x0cdf
			0x0cfe 0x0d1e 0x0d3e 0x0d5d
			0x0d7e 0x0d9e 0x0dbe 0x0ddf
			0x0e00 0x0e21 0x0e42 0x0e63
			0x0e84 0x0ea6 0x0ec8 0x0eea
			0x0f0c 0x0f2e 0x0f50 0x0f73
			0x0f96 0x0fb9 0x0fdc 0x0fff>;
	};
};
